;
; Definitions.inc
;
; Created: 24/11/2016 13:09:26
; Authors : AL4413, MV914
;


;16 Bit Colours
#define	COLOUR_BLACKL           0x00
#define	COLOUR_BLACKH           0x00
#define COLOUR_GREYL            0x18	;75% grey
#define COLOUR_GREYH            0xc6
#define COLOUR_WHITEL           0xFF
#define COLOUR_WHITEH           0xFF
#define	COLOUR_REDL             0x00
#define	COLOUR_REDH             0xF8
#define	COLOUR_GREENL           0xE0
#define	COLOUR_GREENH           0x07
#define	COLOUR_BLUEL            0x1F
#define	COLOUR_BLUEH            0x00
#define COLOUR_CYANL            0xFF
#define COLOUR_CYANH            0x07
#define COLOUR_MAGENTAL         0x1F
#define COLOUR_MAGENTAH         0xF8
#define COLOUR_YELLOWL          0xE0  
#define COLOUR_YELLOWH          0xFF

